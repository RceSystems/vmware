## conf/bblayers.conf
```bitbake
# POKY_BBLAYERS_CONF_VERSION is increased each time build/conf/bblayers.conf
# changes incompatibly
POKY_BBLAYERS_CONF_VERSION = "2"

BBPATH = "${TOPDIR}"
BBFILES ?= ""

BBLAYERS ?= " \
  /home/build/var-fslc-yocto/sources/poky/meta \
  /home/build/var-fslc-yocto/sources/poky/meta-poky \
  /home/build/var-fslc-yocto/sources/poky/meta-yocto-bsp \
  \
  /home/build/var-fslc-yocto/sources/meta-openembedded/meta-oe \
  /home/build/var-fslc-yocto/sources/meta-openembedded/meta-multimedia \
  /home/build/var-fslc-yocto/sources/meta-openembedded/meta-python \
  /home/build/var-fslc-yocto/sources/meta-openembedded/meta-filesystems \
  /home/build/var-fslc-yocto/sources/meta-openembedded/meta-networking \
"
```
